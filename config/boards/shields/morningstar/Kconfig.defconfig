## config/boards/shields/morningstar/Kconfig.defconfig
```kconfig
if SHIELD_MORNINGSTAR_LEFT

config ZMK_KEYBOARD_NAME
    default "Morning Star"

config ZMK_SPLIT_ROLE_CENTRAL
    default y

endif

if SHIELD_MORNINGSTAR_LEFT || SHIELD_MORNINGSTAR_RIGHT

config ZMK_SPLIT
    default y

endif
```

## config/boards/shields/morningstar/Kconfig.shield
```kconfig
config SHIELD_MORNINGSTAR_LEFT
    def_bool $(shields_list_contains,morningstar_left)

config SHIELD_MORNINGSTAR_RIGHT
    def_bool $(shields_list_contains,morningstar_right)
```
